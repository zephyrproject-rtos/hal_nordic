#include "../../../common/common-pinctrl.dtsi"

&i2c0 {
    status = "okay";
    compatible = "nordic,nrf-twim";
    pinctrl-0 = <&i2c_master_dummy>;
};

&i2c1 {
    status = "okay";
    compatible = "nordic,nrf-twis";
    pinctrl-0 = <&i2c_slave_dummy>;
};
