#include "../../../common/common-pinctrl.dtsi"

&i2c1 {
    status = "okay";
    compatible = "nordic,nrf-twim";
    pinctrl-0 = <&i2c_master_dummy>;
    pinctrl-names = "default";
};

&uart1 {
    status = "disabled";
};

&i2c2 {
    status = "okay";
    compatible = "nordic,nrf-twis";
    pinctrl-0 = <&i2c_slave_dummy>;
    pinctrl-names = "default", "sleep";
};
