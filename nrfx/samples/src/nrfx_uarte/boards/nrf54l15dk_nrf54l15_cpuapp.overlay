/ {
    chosen {
        zephyr,console = &uart30;
    };
};

/* UARTE used in the sample needs to be disabled due to a conflict in connecting irq handlers. */
&uart20 {
    status = "disabled";
    compatible = "nordic,nrf-uarte";
};

&uart30 {
    status = "okay";
};
