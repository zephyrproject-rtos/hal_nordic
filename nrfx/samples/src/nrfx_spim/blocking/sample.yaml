## nrfx/samples/src/nrfx_spim/blocking/sample.yaml
```yaml
sample:
  description: An example to showcase usage of the nrfx_spim driver in the blocking mode
  name: nrfx_spim blocking example
tests:
  examples.nrfx_spim.blocking:
    tags: spim
    filter: dt_compat_enabled("nordic,nrf-spim")
    platform_allow:
      - nrf52dk/nrf52832
      - nrf52833dk/nrf52833
      - nrf52840dk/nrf52840
      - nrf5340dk/nrf5340/cpuapp
      - nrf9160dk/nrf9160
    integration_platforms:
      - nrf52dk/nrf52832
      - nrf52833dk/nrf52833
      - nrf52840dk/nrf52840
      - nrf5340dk/nrf5340/cpuapp
      - nrf9160dk/nrf9160
    harness: console
    harness_config:
      fixture: nrfx_example_loopbacks
      type: multi_line
      ordered: true
      regex:
        - "Starting nrfx_spim basic blocking example."
        - "Message received: Nordic Semiconductor"
```

## nrfx/samples/src/nrfx_spim/non_blocking/sample.yaml
```yaml
sample:
  description: An example to showcase usage of the nrfx_spim driver in the non-blocking mode
  name: nrfx_spim non-blocking example
tests:
  examples.nrfx_spim.non_blocking:
    tags: spim
    filter: dt_compat_enabled("nordic,nrf-spim")
    platform_allow:
      - nrf52dk/nrf52832
      - nrf52833dk/nrf52833
      - nrf52840dk/nrf52840
      - nrf5340dk/nrf5340/cpuapp
      - nrf9160dk/nrf9160
    integration_platforms:
      - nrf52dk/nrf52832
      - nrf52833dk/nrf52833
      - nrf52840dk/nrf52840
      - nrf5340dk/nrf5340/cpuapp
      - nrf9160dk/nrf9160
    harness: console
    harness_config:
      fixture: nrfx_example_loopbacks
      type: multi_line
      ordered: true
      regex:
        - "Starting nrfx_spim basic non-blocking example."
        - "SPIM finished. Context passed to the handler: >Some context<"
        - "Message received: Nordic Semiconductor"
```

## nrfx/samples/src/nrfx_spim_spis/advanced_non_blocking/sample.yaml
```yaml
sample:
  description: An example to showcase usage of the nrfx_spim and nrfx_spis drivers in the non-blocking mode
  name: nrfx_spim_spis advanced non-blocking example
tests:
  examples.nrfx_spim_spis.advanced_non_blocking:
    tags:
      - spim
      - spis
    filter: dt_compat_enabled("nordic,nrf-spim") and dt_compat_enabled("nordic,nrf-spis")
    platform_allow:
      - nrf52dk/nrf52832
      - nrf52833dk/nrf52833
      - nrf52840dk/nrf52840
      - nrf5340dk/nrf5340/cpuapp
      - nrf9160dk/nrf9160
    integration_platforms:
      - nrf52dk/nrf52832
      - nrf52833dk/nrf52833
      - nrf52840dk/nrf52840
      - nrf5340dk/nrf5340/cpuapp
      - nrf9160dk/nrf9160
    harness: console
    harness_config:
      type: multi_line
      ordered: true
      regex:
        - "Starting nrfx_spim_spis advanced non-blocking example."
        - "SPIM finished. >Some context<"
        - "SPIM: Message transmitted: Nordic"
        - "SPIS finished."
        - "SPIS: Message received: Nordic"
        - "SPIM finished. >Some context<"
        - "SPIM: Message received: Semi"
        - "SPIS finished."
        - "SPIS: Message transmitted: Semi"
        - "SPIM finished. >Some context<"
        - "SPIM: Message transmitted: Unknown"
        - "SPIS finished."
        - "SPIS: Message received: Unknown"
        - "SPIM finished. >Some context<"
        - "SPIM: Message received: ERROR"
        - "SPIS finished."
        - "SPIS: Message transmitted: ERROR"
        - "SPIM finished. >Some context<"
        - "SPIM: Message transmitted: Uninit"
        - "SPIS finished."
        - "SPIS: Message received: Uninit"
```

## nrfx/samples/src/nrfx_spim_spis/non_blocking/sample.yaml
```yaml
sample:
  description: An example to showcase usage of the nrfx_spim and nrfx_spis drivers in the non-blocking mode
  name: nrfx_spim_spis Non-blocking example
tests:
  examples.nrfx_spim_spis.non_blocking:
    tags:
      - spim
      - spis
    platform_allow:
      - nrf52dk/nrf52832
      - nrf52833dk/nrf52833
      - nrf52840dk/nrf52840
      - nrf5340dk/nrf5340/cpuapp
      - nrf54l15dk/nrf54l15/cpuapp
      - nrf9160dk/nrf9160
    integration_platforms:
      - nrf52833dk/nrf52833
      - nrf54l15dk/nrf54l15/cpuapp
    harness: console
    harness_config:
      fixture: nrfx_example_loopbacks
      type: multi_line
      ordered: true
      regex:
        - "Starting nrfx_spim_spis basic non-blocking example."
        - "SPIM finished. Context passed to the handler: >Some context<"
        - "SPIM rx buffer: Nordic"
        - "SPIS finished. Context passed to the handler: >Some context<"
        - "SPIS rx buffer: Semiconductor"
```

## nrfx/samples/src/nrfx_temp/blocking/sample.yaml
```yaml
sample:
  description: An example to showcase usage of the nrfx_temp driver in the blocking mode
  name: nrfx_temp blocking example
tests:
  examples.nrfx_temp.blocking:
    tags: temp
    filter: dt_compat_enabled("nordic,nrf-temp")
    platform_allow:
      - nrf52dk/nrf52832
      - nrf52833dk/nrf52833
      - nrf52840dk/nrf52840
      - nrf5340dk/nrf5340/cpunet
    integration_platforms:
      - nrf52dk/nrf52832
      - nrf52833dk/nrf52833
      - nrf52840dk/nrf52840
      - nrf5340dk/nrf5340/cpunet
    harness: console
    harness_config:
      type: multi_line
      ordered: true
      regex:
        - "Starting nrfx_temp blocking example."
        - "Measured temperature: ([0-9]*).([0-9]{2}) .C."
        - "Measured temperature: ([0-9]*).([0-9]{2}) .C."
        - "Measured temperature: ([0-9]*).([0-9]{2}) .C."
        - "Measured temperature: ([0-9]*).([0-9]{2}) .C."
        - "Measured temperature: ([0-9]*).([0-9]{2}) .C."
```

## nrfx/samples/src/nrfx_temp/non_blocking/sample.yaml
```yaml
sample:
  description: An example to showcase usage of the nrfx_temp driver in the non-blocking mode
  name: nrfx_temp non-blocking example
tests:
  examples.nrfx_temp.non_blocking:
    tags: temp
    filter: dt_compat_enabled("nordic,nrf-temp")
    platform_allow:
      - nrf52dk/nrf52832
      - nrf52833dk/nrf52833
      - nrf52840dk/nrf52840
      - nrf5340dk/nrf5340/cpunet
    integration_platforms:
      - nrf52dk/nrf52832
      - nrf52833dk/nrf52833
      - nrf52840dk/nrf52840
      - nrf5340dk/nrf5340/cpunet
    harness: console
    harness_config:
      type: multi_line
      ordered: true
      regex:
        - "Starting nrfx_temp non-blocking example."
        - "Measured temperature: ([0-9]*).([0-9]{2}) .C."
        - "Measured temperature: ([0-9]*).([0-9]{2}) .C."
        - "Measured temperature: ([0-9]*).([0-9]{2}) .C."
        - "Measured temperature: ([0-9]*).([0-9]{2}) .C."
        - "Measured temperature: ([0-9]*).([0-9]{2}) .C."
```

## nrfx/samples/src/nrfx_timer/counter/sample.yaml
```yaml
sample:
  description: An example to showcase usage of the nrfx_timer driver when timer is in counter mode.
  name: nrfx_timer counter mode example
tests:
  examples.nrfx_timer.counter:
    tags: timer
    filter: dt_compat_enabled("nordic,nrf-timer")
    platform_allow:
      - nrf52dk/nrf52832
      - nrf52833dk/nrf52833
      - nrf52840dk/nrf52840
      - nrf5340dk/nrf5340/cpuapp
      - nrf9160dk/nrf9160
    integration_platforms:
      - nrf52dk/nrf52832
      - nrf52833dk/nrf52833
      - nrf52840dk/nrf52840
      - nrf5340dk/nrf5340/cpuapp
      - nrf9160dk/nrf9160
    harness: console
    harness_config:
      type: multi_line
      ordered: true
      regex:
        - "Starting nrfx_timer basic counter example."
        - "Time between timer ticks: 1000 ms"
        - "Timer status: enabled"
        - "Counter status: enabled"
        - "Timer: 1"
        - "Timer: 2"
        - "Timer: 3"
        - "Counter: 1 / 3"
        - "Timer: 1"
        - "Timer: 2"
        - "Timer: 3"
        - "Counter: 2 / 3"
        - "Timer: 1"
        - "Timer: 2"
        - "Timer: 3"
        - "Counter finished"
        - "Counter: 3 / 3"
        - "Timer status: disabled"
        - "Counter status: disabled"
```

## nrfx/samples/src/nrfx_timer/timer/sample.yaml
```yaml
sample:
  description: An example to showcase usage of the nrfx_timer driver
  name: nrfx_timer timer example
tests:
  examples.nrfx_timer.timer:
    tags: timer
    filter: dt_compat_enabled("nordic,nrf-timer")
    platform_allow:
      - nrf52dk/nrf52832
      - nrf52833dk/nrf52833
      - nrf52840dk/nrf52840
      - nrf5340dk/nrf5340/cpuapp
      - nrf9160dk/nrf9160
    integration_platforms:
      - nrf52dk/nrf52832
      - nrf52833dk/nrf52833
      - nrf52840dk/nrf52840
      - nrf5340dk/nrf5340/cpuapp
      - nrf9160dk/nrf9160
    harness: console
    harness_config:
      type: multi_line
      ordered: true
      regex:
        - "Starting nrfx_timer basic example"
        - "Time to wait: (.*) ms"
        - "Timer status: (.*)"
        - "Timer finished. Context passed to the handler: >Some context<"
```

## nrfx/samples/src/nrfx_twim_twis/tx_rx_blocking/sample.yaml
```yaml
sample:
  description: An example to showcase usage of the nrfx_twim and nrfx_twis drivers in the blocking mode, with the use of TX or RX TWI transfer descriptor.
  name: nrfx_twim_twis tx_rx_blocking example
tests:
  examples.nrfx_twim_twis.blocking:
    tags:
      - twim
      - twis
    filter: dt_compat_enabled("nordic,nrf-twim") and dt_compat_enabled("nordic,nrf-twis")
    platform_allow:
      - nrf52dk/nrf52832
      - nrf52833dk/nrf52833
      - nrf52840dk/nrf52840
      - nrf5340dk/nrf5340/cpuapp
      - nrf9160dk/nrf9160
    integration_platforms:
      - nrf52dk/nrf52832
      - nrf52833dk/nrf52833
      - nrf52840dk/nrf52840
      - nrf5340dk/nrf5340/cpuapp
      - nrf9160dk/nrf9160
    harness: console
    harness_config:
      fixture: nrfx_example_loopbacks
      type: multi_line
      ordered: true
      regex:
        - "Starting nrfx_twim_twis blocking example."
        - "Message to send: Nordic Semiconductor"
        - "Content of slave RX buffer:  "
        - "Content of master RX buffer: "
        - "m_tx_buffer_master -> m_rx_buffer_slave -> m_rx_buffer_master"
        - "Content of slave RX buffer:  Nordic Semiconductor"
        - "Content of master RX buffer: Nordic Semiconductor"
```

## nrfx/samples/src/nrfx_twim_twis/tx_rx_non_blocking/sample.yaml
```yaml
sample:
  description: An example to showcase usage of the nrfx_twim and nrfx_twis drivers in the non-blocking mode, with the use of TX or RX TWI transfer descriptor.
  name: nrfx_twim_twis tx_rx_non_blocking example
tests:
  examples.nrfx_twim_twis.non_blocking:
    tags:
      - twim
      - twis
    filter: dt_compat_enabled("nordic,nrf-twim") and dt_compat_enabled("nordic,nrf-twis")
    platform_allow:
      - nrf52dk/nrf52832
      - nrf52833dk/nrf52833
      - nrf52840dk/nrf52840
      - nrf5340dk/nrf5340/cpuapp
      - nrf9160dk/nrf9160
    integration_platforms:
      - nrf52dk/nrf52832
      - nrf52833dk/nrf52833
      - nrf52840dk/nrf52840
      - nrf5340dk/nrf5340/cpuapp
      - nrf9160dk/nrf9160
    harness: console
    harness_config:
      fixture: nrfx_example_loopbacks
      type: multi_line
      ordered: false
      regex:
        - "Starting nrfx_twim_twis non-blocking example."
        - "Message to send: Nordic Semiconductor"
        - "Content of master RX buffer:"
        - "--> Slave event: write request"
        - "--> Slave event: write done."
        - "--> Master event: done - transfer completed"
        - "--> Slave event: read request"
        - "--> Slave event: read done."
        - "Content of master RX buffer: Nordic Semiconductor"
```

## nrfx/samples/src/nrfx_twim_twis/txrx/sample.yaml
```yaml
sample:
  description: An example to showcase usage of the nrfx_twim and nrfx_twis drivers, with the use of TXRX TWI transfer descriptor.
  name: nrfx_twim_twis txrx example
tests:
  examples.nrfx_twim_twis.txrx:
    tags:
      - twim
      - twis
    filter: dt_compat_enabled("nordic,nrf-twim") and dt_compat_enabled("nordic,nrf-twis")
    platform_allow:
      - nrf52dk/nrf52832
      - nrf52833dk/nrf52833
      - nrf52840dk/nrf52840
      - nrf5340dk/nrf5340/cpuapp
      - nrf9160dk/nrf9160
    integration_platforms:
      - nrf52dk/nrf52832
      - nrf52833dk/nrf52833
      - nrf52840dk/nrf52840
      - nrf5340dk/nrf5340/cpuapp
      - nrf9160dk/nrf9160
    harness: console
    harness_config:
      fixture: nrfx_example_loopbacks
      type: multi_line
      ordered: true
      regex:
        - "Starting nrfx_twim_twis txrx example."
        - "................................"
        - "DRONE REGISTERS:    DEC  |  HEX"
        - "drone_idx:          1    |  0x1"
        - "drone_mass:         10   |  0xA"
        - "x_force:            50   |  0x32"
        - "y_force:            100  |  0x64"
        - "z_force:            150  |  0x96"
        - "x_acceleration:     5    |  0x5"
        - "y_acceleration:     10   |  0xA"
        - "z_acceleration:     15   |  0xF"
        - "additional_data[0]: 239  |  0xEF"
        - "additional_data[1]: 190  |  0xBE"
        - "additional_data[2]: 173  |  0xAD"
        - "additional_data[3]: 222  |  0xDE"
        - "................................"
        - "Reading value of DRONE_REG_FORCE_X register:"
        - "--> Master event: done - transfer completed"
        - "ctrl buff: 0x32"
        - "..."
        - "Reading value of DRONE_REG_ACC_Y register:"
        - "--> Master event: done - transfer completed"
        - "ctrl buff: 0xA"
        - "..."
        - "Reading values of DRONE_REG_DATA registers:"
        - "--> Master event: done - transfer completed"
        - "ctrl buff: 0xDEADBEEF"
        - "..."
```

## nrfx/samples/src/nrfx_twim_twis/txtx/sample.yaml
```yaml
sample:
  description: An example to showcase usage of the nrfx_twim and nrfx_twis drivers, with the use of TXTX TWI transfer descriptor.
  name: nrfx_twim_twis txtx example
tests:
  examples.nrfx_twim_twis.txtx:
    tags:
      - twim
      - twis
    filter: dt_compat_enabled("nordic,nrf-twim") and dt_compat_enabled("nordic,nrf-twis")
    platform_allow:
      - nrf52dk/nrf52832
      - nrf52833dk/nrf52833
      - nrf52840dk/nrf52840
      - nrf5340dk/nrf5340/cpuapp
      - nrf9160dk/nrf9160
    integration_platforms:
      - nrf52dk/nrf52832
      - nrf52833dk/nrf52833
      - nrf52840dk/nrf52840
      - nrf5340dk/nrf5340/cpuapp
      - nrf9160dk/nrf9160
    harness: console
    harness_config:
      fixture: nrfx_example_loopbacks
      type: multi_line
      ordered: true
      regex:
        - "Starting nrfx_twim_twis txtx example."
        - "..............................."
        - "DRONE REGISTERS:    DEC  |  HEX"
        - "drone_idx:          1    |  0x1"
        - "drone_mass:         10   |  0xA"
        - "x_force:            0    |  0x0"
        - "y_force:            0    |  0x0"
        - "z_force:            0    |  0x0"
        - "x_acceleration:     0    |  0x0"
        - "y_acceleration:     0    |  0x0"
        - "z_acceleration:     0    |  0x0"
        - "additional_data[0]: 0    |  0x0"
        - "additional_data[1]: 0    |  0x0"
        - "additional_data[2]: 0    |  0x0"
        - "additional_data[3]: 0    |  0x0"
        - "..............................."
        - "MASTER EVENTS:"
        - "--> Master event: done - transfer completed"
        - "--> Master event: done - transfer completed"
        - "--> Master event: done - transfer completed"
        - "--> Master event: done - transfer completed"
        - "TXTX transfers finished."
        - "..............................."
        - "DRONE REGISTERS:    DEC  |  HEX"
        - "drone_idx:          1    |  0x1"
        - "drone_mass:         10   |  0xA"
        - "x_force:            50   |  0x32"
        - "y_force:            100  |  0x64"
        - "z_force:            150  |  0x96"
        - "x_acceleration:     5    |  0x5"
        - "y_acceleration:     10   |  0xA"
        - "z_acceleration:     15   |  0xF"
        - "additional_data[0]: 239  |  0xEF"
        - "additional_data[1]: 190  |  0xBE"
        - "additional_data[2]: 173  |  0xAD"
        - "additional_data[3]: 222  |  0xDE"
```
