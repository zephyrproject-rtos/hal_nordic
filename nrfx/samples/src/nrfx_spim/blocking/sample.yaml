## nrfx/samples/src/nrfx_uarte/rx_double_buffered/sample.yaml
```yaml
sample:
  description: An example to showcase usage of the nrfx_uarte driver in the double-buffered mode.
  name: nrfx_uarte rx_double_buffered example
tests:
  examples.nrfx_uarte.rx_double_buffered:
    tags: uarte
    filter: dt_compat_enabled("nordic,nrf-uarte")
    platform_allow:
      - nrf52833dk/nrf52833
      - nrf52840dk/nrf52840
      - nrf5340dk/nrf5340/cpuapp
      - nrf9160dk/nrf9160
    integration_platforms:
      - nrf52833dk/nrf52833
      - nrf52840dk/nrf52840
      - nrf5340dk/nrf5340/cpuapp
      - nrf9160dk/nrf9160
    harness: console
    harness_config:
      fixture: nrfx_example_loopbacks
      type: multi_line
      ordered: true
      regex:
        - "Starting nrfx_uarte RX double-buffered example."
        - "Content of TX buffer: Nordic Semiconductor nRF"
        - "................................"
        - "RX buffer1 - addr: (.*) | content:"
        - "RX buffer2 - addr: (.*) | content:"
        - "RX buffer3 - addr: (.*) | content:"
        - "................................"
        - "--> TX done"
        - "--> Bytes transfered: 27"
        - "................................"
        - "RX buffer1 - addr: (.*) | content: Nordic"
        - "RX buffer2 - addr: (.*) | content:  nRF"
        - "RX buffer3 - addr: (.*) | content:  Secmiconductor"
        - "................................"
```

## nrfx/samples/src/nrfx_uarte/tx_rx_non_blocking/sample.yaml
```yaml
sample:
  description: An example to showcase usage of the nrfx_uarte driver in the non-blocking mode.
  name: nrfx_uarte tx_rx_non_blocking example
tests:
  examples.nrfx_uarte.tx_rx_non_blocking:
    tags: uarte
    filter: dt_compat_enabled("nordic,nrf-uarte")
    platform_allow:
      - nrf52833dk/nrf52833
      - nrf52840dk/nrf52840
      - nrf5340dk/nrf5340/cpuapp
      - nrf9160dk/nrf9160
    integration_platforms:
      - nrf52833dk/nrf52833
      - nrf52840dk/nrf52840
      - nrf5340dk/nrf5340/cpuapp
      - nrf9160dk/nrf9160
    harness: console
    harness_config:
      fixture: nrfx_example_loopbacks
      type: multi_line
      ordered: true
      regex:
        - "Starting nrfx_uarte non-blocking example."
        - "Content of TX buffer: Nordic Semiconductor"
        - "Content of RX buffer: "
        - "--> UARTE event: TX done"
        - "Content of TX buffer: Nordic Semiconductor"
        - "Content of RX buffer: Nordic Semiconductor"
```
