#include "../../../common/common-pinctrl.dtsi"

&spi1 {
    status = "okay";
    compatible = "nordic,nrf-spim";
    pinctrl-0 = <&spi_master_default>;
};

&uart1 {
    status = "disabled";
};

&spi2 {
    status = "okay";
    compatible = "nordic,nrf-spis";
    pinctrl-0 = <&spi_slave_dummy>;
    def-char = <0xFF>;
};
