## nrfx/samples/src/nrfx_saadc/advanced_non_blocking_internal_timer/sample.yaml
```yaml
sample:
  description: An example to showcase usage of the nrfx_saadc driver in the advanced non-blocking continuous sampling mode with internal timer
  name: nrfx_saadc advanced non-blocking sampling with internal timer example
tests:
  examples.nrfx_saadc.advanced_non_blocking_internal_timer:
    tags: saadc
    filter: dt_compat_enabled("nordic,nrf-saadc")
    platform_allow:
      - nrf52833dk/nrf52833
      - nrf52840dk/nrf52840
      - nrf5340dk/nrf5340/cpuapp
      - nrf9160dk/nrf9160
    integration_platforms:
      - nrf52833dk/nrf52833
      - nrf52840dk/nrf52840
      - nrf5340dk/nrf5340/cpuapp
      - nrf9160dk/nrf9160
    harness: console
    harness_config:
      fixture: nrfx_example_loopbacks
      type: multi_line
      ordered: true
      regex:
        - "Starting nrfx_saadc advanced non-blocking sampling with internal timer example."
        - "SAADC event: CALIBRATEDONE"
        - "SAADC event: READY"
        - "SAADC event: BUF_REQ"
        - "SAADC event: DONE"
        - "Sample buffer address == 0x([0-9a-z]{8})"
        - ".Sample 0. value == -?[0-9]"
        - ".Sample 1. value == ([0-9]{3})"
        - ".Sample 2. value == -?[0-9]"
        - "SAADC event: BUF_REQ"
        - "SAADC event: DONE"
        - "Sample buffer address == 0x([0-9a-z]{8})"
        - ".Sample 0. value == ([0-9]{3})"
        - ".Sample 1. value == -?[0-9]"
        - ".Sample 2. value == ([0-9]{3})"
        - "SAADC event: BUF_REQ"
        - "SAADC event: DONE"
        - "Sample buffer address == 0x([0-9a-z]{8})"
        - ".Sample 0. value == -?[0-9]"
        - ".Sample 1. value == ([0-9]{3})"
        - ".Sample 2. value == -?[0-9]"
        - "SAADC event: BUF_REQ"
        - "SAADC event: DONE"
        - "Sample buffer address == 0x([0-9a-z]{8})"
        - ".Sample 0. value == ([0-9]{3})"
        - ".Sample 1. value == -?[0-9]"
        - ".Sample 2. value == ([0-9]{3})"
        - "SAADC event: FINISHED"
```

## nrfx/samples/src/nrfx_saadc/maximum_performance/sample.yaml
```yaml
sample:
  description: An example to showcase usage of the nrfx_saadc driver operating at its peak performance
  name: nrfx_saadc maximum performance example
tests:
  examples.nrfx_saadc.maximum_performance:
    tags: saadc
    platform_allow:
      - nrf52833dk/nrf52833
      - nrf52840dk/nrf52840
      - nrf9160dk/nrf9160
      - nrf54l15dk/nrf54l15/cpuapp
    integration_platforms:
      - nrf52833dk/nrf52833
      - nrf52840dk/nrf52840
      - nrf9160dk/nrf9160
      - nrf54l15dk/nrf54l15/cpuapp
    harness: console
    harness_config:
      fixture: nrfx_example_loopbacks
      type: multi_line
      ordered: true
      regex:
        - "Starting nrfx_saadc maximum performance example."
        - "SAADC event: CALIBRATEDONE"
        - "SAADC event: READY"
        - "SAADC event: BUF_REQ"
        - "SAADC event: DONE"
        - "Sample buffer address == 0x([0-9a-z]{8})"
        - ".Sample 0. value == -?[0-9]"
        - ".Sample 1. value == ([0-9]{4})"
        - "SAADC event: BUF_REQ"
        - "SAADC event: DONE"
        - "Sample buffer address == 0x([0-9a-z]{8})"
        - ".Sample 0. value == -?[0-9]"
        - ".Sample 1. value == ([0-9]{4})"
        - "SAADC event: BUF_REQ"
        - "SAADC event: DONE"
        - ".Sample 0. value == -?[0-9]"
        - ".Sample 1. value == ([0-9]{4})"
```

## nrfx/samples/src/nrfx_saadc/simple_blocking/sample.yaml
```yaml
sample:
  description: An example to showcase usage of the nrfx_saadc driver in the blocking mode
  name: nrfx_saadc simple blocking example
tests:
  examples.nrfx_saadc.simple_blocking:
    tags: saadc
    filter: dt_compat_enabled("nordic,nrf-saadc")
    platform_allow:
      - nrf52dk/nrf52832
      - nrf52833dk/nrf52833
      - nrf52840dk/nrf52840
      - nrf5340dk/nrf5340/cpuapp
      - nrf9160dk/nrf9160
    integration_platforms:
      - nrf52dk/nrf52832
      - nrf52833dk/nrf52833
      - nrf52840dk/nrf52840
      - nrf5340dk/nrf5340/cpuapp
      - nrf9160dk/nrf9160
    harness: console
    harness_config:
      fixture: nrfx_example_loopbacks
      type: multi_line
      ordered: true
      regex:
      - "Starting nrfx_saadc simple blocking example."
      - "Single channel SAADC test."
      - "Calibration in the blocking manner finished successfully."
      - "Sampling 1 / 8"
      - ".CHANNEL 0. Sampled value == ([0-9]{3})"
      - "Calibration in the blocking manner finished successfully."
      - "Sampling 2 / 8"
      - ".CHANNEL 0. Sampled value == -?[0-9]"
      - "Calibration in the blocking manner finished successfully."
      - "Sampling 3 / 8"
      - ".CHANNEL 0. Sampled value == ([0-9]{3})"
      - "Calibration in the blocking manner finished successfully."
      - "Sampling 4 / 8"
      - ".CHANNEL 0. Sampled value == -?[0-9]"
      - "Calibration in the blocking manner finished successfully."
      - "Sampling 5 / 8"
      - ".CHANNEL 0. Sampled value == ([0-9]{3})"
      - "Calibration in the blocking manner finished successfully."
      - "Sampling 6 / 8"
      - ".CHANNEL 0. Sampled value == -?[0-9]"
      - "Calibration in the blocking manner finished successfully."
      - "Sampling 7 / 8"
      - ".CHANNEL 0. Sampled value == ([0-9]{3})"
      - "Calibration in the blocking manner finished successfully."
      - "Sampling 8 / 8"
      - ".CHANNEL 0. Sampled value == -?[0-9]"
      - "Multiple channels SAADC test."
      - "Calibration in the blocking manner finished successfully."
      - "Sampling 1 / 8"
      - ".CHANNEL 0. Sampled value == ([0-9]{3})"
      - ".CHANNEL 1. Sampled value == ([0-9]{3})"
      - ".CHANNEL 2. Sampled value == ([0-9]{3})"
      - "Calibration in the blocking manner finished successfully."
      - "Sampling 2 / 8"
      - ".CHANNEL 0. Sampled value == -?[0-9]"
      - ".CHANNEL 1. Sampled value == -?[0-9]"
      - ".CHANNEL 2. Sampled value == -?[0-9]"
      - "Calibration in the blocking manner finished successfully."
      - "Sampling 3 / 8"
      - ".CHANNEL 0. Sampled value == ([0-9]{3})"
      - ".CHANNEL 1. Sampled value == ([0-9]{3})"
      - ".CHANNEL 2. Sampled value == ([0-9]{3})"
      - "Calibration in the blocking manner finished successfully."
      - "Sampling 4 / 8"
      - ".CHANNEL 0. Sampled value == -?[0-9]"
      - ".CHANNEL 1. Sampled value == -?[0-9]"
      - ".CHANNEL 2. Sampled value == -?[0-9]"
      - "Calibration in the blocking manner finished successfully."
      - "Sampling 5 / 8"
      - ".CHANNEL 0. Sampled value == ([0-9]{3})"
      - ".CHANNEL 1. Sampled value == ([0-9]{3})"
      - ".CHANNEL 2. Sampled value == ([0-9]{3})"
      - "Calibration in the blocking manner finished successfully."
      - "Sampling 6 / 8"
      - ".CHANNEL 0. Sampled value == -?[0-9]"
      - ".CHANNEL 1. Sampled value == -?[0-9]"
      - ".CHANNEL 2. Sampled value == -?[0-9]"
      - "Calibration in the blocking manner finished successfully."
      - "Sampling 7 / 8"
      - ".CHANNEL 0. Sampled value == ([0-9]{3})"
      - ".CHANNEL 1. Sampled value == ([0-9]{3})"
      - ".CHANNEL 2. Sampled value == ([0-9]{3})"
      - "Calibration in the blocking manner finished successfully."
      - "Sampling 8 / 8"
      - ".CHANNEL 0. Sampled value == -?[0-9]"
      - ".CHANNEL 1. Sampled value == -?[0-9]"
      - ".CHANNEL 2. Sampled value == -?[0-9]"
```

## nrfx/samples/src/nrfx_saadc/simple_non_blocking/sample.yaml
```yaml
sample:
  description: An example to showcase usage of the nrfx_saadc driver in the non-blocking mode
  name: nrfx_saadc simple non-blocking example
tests:
  examples.nrfx_saadc.simple_non_blocking:
    tags: saadc
    filter: dt_compat_enabled("nordic,nrf-saadc")
    platform_allow:
      - nrf52dk/nrf52832
      - nrf52833dk/nrf52833
      - nrf52840dk/nrf52840
      - nrf5340dk/nrf5340/cpuapp
      - nrf9160dk/nrf9160
    integration_platforms:
      - nrf52dk/nrf52832
      - nrf52833dk/nrf52833
      - nrf52840dk/nrf52840
      - nrf5340dk/nrf5340/cpuapp
      - nrf9160dk/nrf9160
    harness: console
    harness_config:
      fixture: nrfx_example_loopbacks
      type: multi_line
      ordered: true
      regex:
        - "Starting nrfx_saadc simple non-blocking example."
        - "Single channel SAADC test."
        - "SAADC event: CALIBRATEDONE"
        - "SAADC event: DONE"
        - ".Sample 0. value == ([0-9]{3})"
        - "SAADC event: CALIBRATEDONE"
        - "SAADC event: DONE"
        - ".Sample 0. value == -?[0-9]"
        - "SAADC event: CALIBRATEDONE"
        - "SAADC event: DONE"
        - ".Sample 0. value == ([0-9]{3})"
        - "SAADC event: CALIBRATEDONE"
        - "SAADC event: DONE"
        - ".Sample 0. value == -?[0-9]"
        - "SAADC event: CALIBRATEDONE"
        - "SAADC event: DONE"
        - ".Sample 0. value == ([0-9]{3})"
        - "SAADC event: CALIBRATEDONE"
        - "SAADC event: DONE"
        - ".Sample 0. value == -?[0-9]"
        - "SAADC event: CALIBRATEDONE"
        - "SAADC event: DONE"
        - ".Sample 0. value == ([0-9]{3})"
        - "SAADC event: CALIBRATEDONE"
        - "SAADC event: DONE"
        - ".Sample 0. value == -?[0-9]"
        - "Multiple channels SAADC test."
        - "SAADC event: CALIBRATEDONE"
        - "SAADC event: DONE"
        - ".Sample 0. value == ([0-9]{3})"
        - ".Sample 1. value == ([0-9]{3})"
        - ".Sample 2. value == ([0-9]{3})"
        - "SAADC event: CALIBRATEDONE"
        - "SAADC event: DONE"
        - ".Sample 0. value == -?[0-9]"
        - ".Sample 1. value == -?[0-9]"
        - ".Sample 2. value == -?[0-9]"
        - "SAADC event: CALIBRATEDONE"
        - "SAADC event: DONE"
        - ".Sample 0. value == ([0-9]{3})"
        - ".Sample 1. value == ([0-9]{3})"
        - ".Sample 2. value == ([0-9]{3})"
        - "SAADC event: CALIBRATEDONE"
        - "SAADC event: DONE"
        - ".Sample 0. value == -?[0-9]"
        - ".Sample 1. value == -?[0-9]"
        - ".Sample 2. value == -?[0-9]"
        - "SAADC event: CALIBRATEDONE"
        - "SAADC event: DONE"
        - ".Sample 0. value == ([0-9]{3})"
        - ".Sample 1. value == ([0-9]{3})"
        - ".Sample 2. value == ([0-9]{3})"
        - "SAADC event: CALIBRATEDONE"
        - "SAADC event: DONE"
        - ".Sample 0. value == -?[0-9]"
        - ".Sample 1. value == -?[0-9]"
        - ".Sample 2. value == -?[0-9]"
        - "SAADC event: CALIBRATEDONE"
        - "SAADC event: DONE"
        - ".Sample 0. value == ([0-9]{3})"
        - ".Sample 1. value == ([0-9]{3})"
        - ".Sample 2. value == ([0-9]{3})"
        - "SAADC event: CALIBRATEDONE"
        - "SAADC event: DONE"
        - ".Sample 0. value == -?[0-9]"
        - ".Sample 1. value == -?[0-9]"
        - ".Sample 2. value == -?[0-9]"
```
