## nrfx/samples/src/nrfx_cracen/sample.yaml
```yaml
sample:
  description: An example to showcase usage of the nrfx_cracen driver
  name: nrfx_cracen example
tests:
  examples.nrfx_cracen:
    tags: cracen
    platform_allow:
      - nrf54l15dk/nrf54l15/cpuapp
    integration_platforms:
      - nrf54l15dk/nrf54l15/cpuapp
    harness: console
    harness_config:
      type: multi_line
      ordered: true
      regex:
        - "Starting nrfx_cracen example"
        - "Generated value: (.*)"
```

## nrfx/samples/src/nrfx_egu/sample.yaml
```yaml
sample:
  description: An example to showcase usage of the nrfx_egu driver
  name: nrfx_egu example
tests:
  examples.nrfx_egu:
    tags: egu
    platform_allow:
      - nrf52dk/nrf52832
      - nrf52833dk/nrf52833
      - nrf52840dk/nrf52840
      - nrf5340dk/nrf5340/cpuapp
      - nrf54l15dk/nrf54l15/cpuapp
      - nrf9160dk/nrf9160
    integration_platforms:
      - nrf52dk/nrf52832
      - nrf52833dk/nrf52833
      - nrf52840dk/nrf52840
      - nrf5340dk/nrf5340/cpuapp
      - nrf54l15dk/nrf54l15/cpuapp
      - nrf9160dk/nrf9160
    harness: console
    harness_config:
      type: multi_line
      ordered: true
      regex:
        - "Starting nrfx_egu example"
        - "EGU handler triggered on channel: (.*). Context passed to the handler: >Some context<"
```

## nrfx/samples/src/nrfx_gppi/fork/sample.yaml
```yaml
sample:
  description: An example to showcase usage of the nrfx_gppi helper
  name: nrfx_gppi fork example
tests:
  examples.nrfx_gppi.fork:
    tags: gppi
    filter: dt_compat_enabled("nordic,nrf-ppi") or dt_compat_enabled("nordic,nrf-dppic")
    platform_allow:
      - nrf52dk/nrf52832
      - nrf52833dk/nrf52833
      - nrf52840dk/nrf52840
      - nrf5340dk/nrf5340/cpuapp
      - nrf9160dk/nrf9160
    integration_platforms:
      - nrf52dk/nrf52832
      - nrf52833dk/nrf52833
      - nrf52840dk/nrf52840
      - nrf5340dk/nrf5340/cpuapp
      - nrf9160dk/nrf9160
    harness: console
    harness_config:
      type: multi_line
      ordered: true
      regex:
        - "Starting nrfx_gppi basic fork example."
        - "GPIOTE status: initialized"
        - "Time to wait: 1000 ms"
        - "Timer status: enabled"
        - "Timer finished. Context passed to the handler: >Some context<"
        - "GPIOTE output pin .primary.: ([0-9]*) is low"
        - "GPIOTE output pin .fork.: ([0-9]*) is high"
        - "Timer finished. Context passed to the handler: >Some context<"
        - "GPIOTE output pin .primary.: ([0-9]*) is high"
        - "GPIOTE output pin .fork.: ([0-9]*) is low"
```

## nrfx/samples/src/nrfx_gppi/one_to_one/sample.yaml
```yaml
sample:
  description: An example to showcase usage of the nrfx_gppi helper
  name: nrfx_gppi one-to-one example
tests:
  examples.nrfx_gppi.one_to_one:
    tags: gppi
    filter: dt_compat_enabled("nordic,nrf-ppi") or dt_compat_enabled("nordic,nrf-dppic")
    platform_allow:
      - nrf52dk/nrf52832
      - nrf52833dk/nrf52833
      - nrf52840dk/nrf52840
      - nrf5340dk/nrf5340/cpuapp
      - nrf9160dk/nrf9160
    integration_platforms:
      - nrf52dk/nrf52832
      - nrf52833dk/nrf52833
      - nrf52840dk/nrf52840
      - nrf5340dk/nrf5340/cpuapp
      - nrf9160dk/nrf9160
    harness: console
    harness_config:
      type: multi_line
      ordered: true
      regex:
        - "Starting nrfx_gppi basic one-to-one example."
        - "GPIOTE status: initialized"
        - "Time to wait: 1000 ms"
        - "Timer status: enabled"
        - "Timer finished. Context passed to the handler: >Some context<"
        - "GPIOTE output pin: ([0-9]*) is low"
        - "Timer finished. Context passed to the handler: >Some context<"
        - "GPIOTE output pin: ([0-9]*) is high"
```

## nrfx/samples/src/nrfx_pwm/common_mode/sample.yaml
```yaml
sample:
  description: An example to showcase usage of the nrfx_pwm driver for sequence loaded in common mode
  name: nrfx_pwm common mode example
tests:
  examples.nrfx_pwm.common_mode:
    tags: pwm
    platform_allow:
      - nrf52dk/nrf52832
      - nrf52833dk/nrf52833
      - nrf52840dk/nrf52840
      - nrf5340dk/nrf5340/cpuapp
      - nrf54l15dk/nrf54l15/cpuapp
      - nrf9160dk/nrf9160
    integration_platforms:
      - nrf52dk/nrf52832
      - nrf52833dk/nrf52833
      - nrf52840dk/nrf52840
      - nrf54l15dk/nrf54l15/cpuapp
    harness: console
    harness_config:
      type: multi_line
      ordered: true
      regex:
        - "Starting nrfx_pwm example for sequence loaded in common mode."
        - "Loops: 1 / 3"
        - "Loops: 2 / 3"
        - "Loops: 3 / 3"
        - "PWM finished"
```

## nrfx/samples/src/nrfx_pwm/grouped_mode/sample.yaml
```yaml
sample:
  description: An example to showcase usage of the nrfx_pwm driver for sequences loaded in grouped mode.
  name: nrfx_pwm grouped mode example
tests:
  examples.nrfx_pwm.grouped_mode:
    tags: pwm
    filter: dt_compat_enabled("nordic,nrf-pwm")
    platform_allow:
      - nrf52dk/nrf52832
      - nrf52833dk/nrf52833
      - nrf52840dk/nrf52840
      - nrf5340dk/nrf5340/cpuapp
      - nrf9160dk/nrf9160
    integration_platforms:
      - nrf52dk/nrf52832
      - nrf52833dk/nrf52833
      - nrf52840dk/nrf52840
      - nrf5340dk/nrf5340/cpuapp
      - nrf9160dk/nrf9160
    harness: console
    harness_config:
      type: multi_line
      ordered: true
      regex:
        - "Starting nrfx_pwm example for sequences loaded in grouped mode."
        - "Loops: 1 / 6"
        - "SEQ1 changed to sequence number 2 from the seq array"
        - "Loops: 2 / 6"
        - "SEQ1 changed to sequence number 1 from the seq array"
        - "Loops: 3 / 6"
        - "SEQ1 changed to sequence number 2 from the seq array"
        - "Loops: 4 / 6"
        - "SEQ1 changed to sequence number 1 from the seq array"
        - "Loops: 5 / 6"
        - "SEQ1 changed to sequence number 2 from the seq array"
        - "Loops: 6 / 6"
        - "SEQ1 changed to sequence number 1 from the seq array"
        - "PWM finished"
```

## nrfx/samples/src/nrfx_rng/sample.yaml
```yaml
sample:
  description: An example to showcase usage of the nrfx_rng driver
  name: nrfx_rng example
tests:
  examples.nrfx_rng:
    tags: rng
    platform_allow:
      - nrf52dk/nrf52832
      - nrf52833dk/nrf52833
      - nrf52840dk/nrf52840
      - nrf5340dk/nrf5340/cpunet
    integration_platforms:
      - nrf52833dk/nrf52833
      - nrf52840dk/nrf52840
      - nrf5340dk/nrf5340/cpunet
    harness: console
    harness_config:
      type: multi_line
      ordered: true
      regex:
        - "Starting nrfx_rng example"
        - "Generated value: (.*)"
```

## nrfx/samples/src/nrfx_saadc/advanced_blocking/sample.yaml
```yaml
sample:
  description: An example to showcase usage of the nrfx_saadc driver in the advanced blocking mode
  name: nrfx_saadc advanced blocking example
tests:
  examples.nrfx_saadc.advanced_blocking:
    tags: saadc
    filter: dt_compat_enabled("nordic,nrf-saadc")
    platform_allow:
      - nrf52dk/nrf52832
      - nrf52833dk/nrf52833
      - nrf52840dk/nrf52840
      - nrf5340dk/nrf5340/cpuapp
      - nrf9160dk/nrf9160
    integration_platforms:
      - nrf52dk/nrf52832
      - nrf52833dk/nrf52833
      - nrf52840dk/nrf52840
      - nrf5340dk/nrf5340/cpuapp
      - nrf9160dk/nrf9160
    harness: console
    harness_config:
      fixture: nrfx_example_loopbacks
      type: multi_line
      ordered: true
      regex:
        - "Starting nrfx_saadc advanced blocking example."
        - "Calibration in the blocking manner finished successfully."
        - "Sampling 1 / 5"
        - ".Sample 0. value == ([0-9]{3})"
        - ".Sample 1. value == ([0-9]{3})"
        - "Calibration in the blocking manner finished successfully."
        - "Sampling 2 / 5"
        - ".Sample 0. value == -?[0-9]"
        - ".Sample 1. value == -?[0-9]"
        - "Calibration in the blocking manner finished successfully."
        - "Sampling 3 / 5"
        - ".Sample 0. value == ([0-9]{3})"
        - ".Sample 1. value == ([0-9]{3})"
        - "Calibration in the blocking manner finished successfully."
        - "Sampling 4 / 5"
        - ".Sample 0. value == -?[0-9]"
        - ".Sample 1. value == -?[0-9]"
        - "Calibration in the blocking manner finished successfully."
        - "Sampling 5 / 5"
        - ".Sample 0. value == ([0-9]{3})"
        - ".Sample 1. value == ([0-9]{3})"
```

## nrfx/samples/src/nrfx_saadc/advanced_non_blocking_internal_timer/build_1/Kconfig/Kconfig.modules
```kconfig
menu "nrf (/home/cortex/ncs/v2.6.1/nrf)"
osource "/home/cortex/ncs/v2.6.1/nrf/Kconfig.nrf"
config ZEPHYR_NRF_MODULE
	bool
	default y
endmenu
menu "mcuboot (/home/cortex/ncs/v2.6.1/bootloader/mcuboot)"
osource "$(ZEPHYR_MCUBOOT_KCONFIG)"
config ZEPHYR_MCUBOOT_MODULE
	bool
	default y
endmenu
menu "mbedtls (/home/cortex/ncs/v2.6.1/modules/crypto/mbedtls)"
osource "$(ZEPHYR_MBEDTLS_KCONFIG)"
config ZEPHYR_MBEDTLS_MODULE
	bool
	default y
endmenu
menu "trusted-firmware-m (/home/cortex/ncs/v2.6.1/modules/tee/tf-m/trusted-firmware-m)"
osource "$(ZEPHYR_TRUSTED_FIRMWARE_M_KCONFIG)"
config ZEPHYR_TRUSTED_FIRMWARE_M_MODULE
	bool
	default y
endmenu
config ZEPHYR_PSA_ARCH_TESTS_MODULE
   bool
   default y
menu "cjson (/home/cortex/ncs/v2.6.1/modules/lib/cjson)"
osource "$(ZEPHYR_CJSON_KCONFIG)"
config ZEPHYR_CJSON_MODULE
	bool
	default y
endmenu
menu "azure-sdk-for-c (/home/cortex/ncs/v2.6.1/modules/lib/azure-sdk-for-c)"
osource "$(ZEPHYR_AZURE_SDK_FOR_C_KCONFIG)"
config ZEPHYR_AZURE_SDK_FOR_C_MODULE
	bool
	default y
endmenu
menu "cirrus-logic (/home/cortex/ncs/v2.6.1/modules/hal/cirrus-logic)"
osource "/home/cortex/ncs/v2.6.1/modules/hal/cirrus-logic/Kconfig"
config ZEPHYR_CIRRUS_LOGIC_MODULE
	bool
	default y
endmenu
menu "openthread (/home/cortex/ncs/v2.6.1/modules/lib/openthread)"
osource "$(ZEPHYR_OPENTHREAD_KCONFIG)"
config ZEPHYR_OPENTHREAD_MODULE
	bool
	default y
endmenu
menu "memfault-firmware-sdk (/home/cortex/ncs/v2.6.1/modules/lib/memfault-firmware-sdk)"
osource "/home/cortex/ncs/v2.6.1/modules/lib/memfault-firmware-sdk/ports/zephyr/Kconfig"
config ZEPHYR_MEMFAULT_FIRMWARE_SDK_MODULE
	bool
	default y
endmenu
menu "canopennode (/home/cortex/ncs/v2.6.1/modules/lib/canopennode)"
osource "$(ZEPHYR_CANOPENNODE_KCONFIG)"
config ZEPHYR_CANOPENNODE_MODULE
	bool
	default y
endmenu
menu "chre (/home/cortex/ncs/v2.6.1/modules/lib/chre)"
osource "/home/cortex/ncs/v2.6.1/modules/lib/chre/platform/zephyr/Kconfig"
config ZEPHYR_CHRE_MODULE
	bool
	default y
endmenu
menu "lz4 (/home/cortex/ncs/v2.6.1/modules/lib/lz4)"
osource "$(ZEPHYR_LZ4_KCONFIG)"
config ZEPHYR_LZ4_MODULE
	bool
	default y
endmenu
menu "nanopb (/home/cortex/ncs/v2.6.1/modules/lib/nanopb)"
osource "$(ZEPHYR_NANOPB_KCONFIG)"
config ZEPHYR_NANOPB_MODULE
	bool
	default y
endmenu
config ZEPHYR_TF_M_TESTS_MODULE
   bool
   default y
menu "zscilib (/home/cortex/ncs/v2.6.1/modules/lib/zscilib)"
osource "/home/cortex/ncs/v2.6.1/modules/lib/zscilib/Kconfig.zscilib"
config ZEPHYR_ZSCILIB_MODULE
	bool
	default y
endmenu
menu "cmsis (/home/cortex/ncs/v2.6.1/modules/hal/cmsis)"
osource "$(ZEPHYR_CMSIS_KCONFIG)"
config ZEPHYR_CMSIS_MODULE
	bool
	default y
endmenu
menu "cmsis-dsp (/home/cortex/ncs/v2.6.1/modules/lib/cmsis-dsp)"
osource "$(ZEPHYR_CMSIS_DSP_KCONFIG)"
config ZEPHYR_CMSIS_DSP_MODULE
	bool
	default y
endmenu
menu "cmsis-nn (/home/cortex/ncs/v2.6.1/modules/lib/cmsis-nn)"
osource "$(ZEPHYR_CMSIS_NN_KCONFIG)"
config ZEPHYR_CMSIS_NN_MODULE
	bool
	default y
endmenu
menu "fatfs (/home/cortex/ncs/v2.6.1/modules/fs/fatfs)"
osource "$(ZEPHYR_FATFS_KCONFIG)"
config ZEPHYR_FATFS_MODULE
	bool
	default y
endmenu
menu "hal_nordic (/home/cortex/ncs/v2.6.1/modules/hal/nordic)"
osource "$(ZEPHYR_HAL_NORDIC_KCONFIG)"
config ZEPHYR_HAL_NORDIC_MODULE
	bool
	default y
endmenu
config ZEPHYR_ST_MODULE
   bool
   default y
config ZEPHYR_HAL_WURTHELEKTRONIK_MODULE
   bool
   default y
config ZEPHYR_LIBMETAL_MODULE
   bool
   default y
menu "liblc3 (/home/cortex/ncs/v2.6.1/modules/lib/liblc3)"
osource "$(ZEPHYR_LIBLC3_KCONFIG)"
config ZEPHYR_LIBLC3_MODULE
	bool
	default y
endmenu
menu "littlefs (/home/cortex/ncs/v2.6.1/modules/fs/littlefs)"
osource "$(ZEPHYR_LITTLEFS_KCONFIG)"
config ZEPHYR_LITTLEFS_MODULE
	bool
	default y
endmenu
menu "loramac-node (/home/cortex/ncs/v2.6.1/modules/lib/loramac-node)"
osource "$(ZEPHYR_LORAMAC_NODE_KCONFIG)"
config ZEPHYR_LORAMAC_NODE_MODULE
	bool
	default y
endmenu
menu "lvgl (/home/cortex/ncs/v2.6.1/modules/lib/gui/lvgl)"
osource "/home/cortex/ncs/v2.6.1/modules/lib/gui/lvgl/Kconfig"
config ZEPHYR_LVGL_MODULE
	bool
	default y
endmenu
config ZEPHYR_MIPI_SYS_T_MODULE
   bool
   default y
config ZEPHYR_NRF_HW_MODELS_MODULE
   bool
   default y
config ZEPHYR_OPEN_AMP_MODULE
   bool
   default y
menu "picolibc (/home/cortex/ncs/v2.6.1/modules/lib/picolibc)"
osource "/home/cortex/ncs/v2.6.1/modules/lib/picolibc/zephyr/Kconfig"
config ZEPHYR_PICOLIBC_MODULE
	bool
	default y
endmenu
menu "segger (/home/cortex/ncs/v2.6.1/modules/debug/segger)"
osource "$(ZEPHYR_SEGGER_KCONFIG)"
config ZEPHYR_SEGGER_MODULE
	bool
	default y
endmenu
config ZEPHYR_TINYCRYPT_MODULE
   bool
   default y
menu "uoscore-uedhoc (/home/cortex/ncs/v2.6.1/modules/lib/uoscore-uedhoc)"
osource "$(ZEPHYR_UOSCORE_UEDHOC_KCONFIG)"
config ZEPHYR_UOSCORE_UEDHOC_MODULE
	bool
	default y
endmenu
menu "zcbor (/home/cortex/ncs/v2.6.1/modules/lib/zcbor)"
osource "$(ZEPHYR_ZCBOR_KCONFIG)"
config ZEPHYR_ZCBOR_MODULE
	bool
	default y
endmenu
menu "nrfxlib (/home/cortex/ncs/v2.6.1/nrfxlib)"
osource "/home/cortex/ncs/v2.6.1/nrfxlib/Kconfig.nrfxlib"
config ZEPHYR_NRFXLIB_MODULE
	bool
	default y
endmenu
menu "connectedhomeip (/home/cortex/ncs/v2.6.1/modules/lib/matter)"
osource "/home/cortex/ncs/v2.6.1/modules/lib/matter/config/nrfconnect/chip-module/Kconfig"
config ZEPHYR_CONNECTEDHOMEIP_MODULE
	bool
	default y
endmenu
```

## nrfx/samples/src/nrfx_saadc/advanced_non_blocking_internal_timer/build_1/Kconfig/Kconfig.sysbuild.modules
```kconfig
menu "nrf (/home/cortex/ncs/v2.6.1/nrf)"
osource "/home/cortex/ncs/v2.6.1/nrf/sysbuild/Kconfig.sysbuild"
config ZEPHYR_NRF_MODULE
	bool
	default y
endmenu
```
