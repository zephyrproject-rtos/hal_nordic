# nrf7120E_enga_wificore register map
Vendor: Nordic Semiconductor; Series: nrf71; File version: 1
System-on-chip with a 32-bit Arm Cortex-M33 microcontroller
Registers are 32-bit, read-write, reset 0x0 unless marked. A register's access mark holds for its fields unless they carry their own. Offsets are from the block's base; lines under a group give offsets from that group; [hi:lo] are bit positions; {n}, {i} and the like mark numbered series; 'fields as' and 'values as' point back to an identical list; <NAME> marks a mode.

## Memory map
0x003FD000 GLOBAL_WICR size 0x1000 — Wi-Fi Information Configuration Registers
0x00FFC000 GLOBAL_FICR size 0x1000 — Factory Information Configuration Registers
0x00FFD000 GLOBAL_UICR size 0x1000 — User Information Configuration Registers
0x00FFE000 GLOBAL_SICR size 0x1000 — Factory Information Configuration Registers
0x40074000 BELLBOARD size 0x1000 — BELLBOARD APB registers
0x48000000 LMAC_VPR size 0x1000 — VPR peripheral registers 0
0x48004000 UMAC_VPR size 0x1000 — VPR peripheral registers 1
0x48008000 MVDMA size 0x1000 — MVDMA performs direct-memory-accesses between memories. Data is transferred according to job descriptor lists. Each transfer has corresponding source and sink descriptor lists with matching data amounts. The lists are in memory and they contain data buffer information, address pointers, buffer sizes and data type attributes.
0x4800B000 LRCCONF_LRC0 size 0x1000 — LRCCONF
0x4800C000 PCGCM_LRC0 size 0x1000 — PCGC Master
0x4800D000 ANTSWC size 0x1000 — Antenna switch controller
0x50010000 GLOBAL_CRACENCORE size 0x1000 — CRACENCORE
0x50020000 GLOBAL_USBHSCORE size 0x24000 — USBHSCORE
0x50040000 GLOBAL_SPU00 size 0x1000 — System protection unit 0
0x50041000 GLOBAL_MPC00 size 0x1000 — Memory Privilege Controller 0
0x50042000 GLOBAL_DPPIC00 size 0x1000 — Distributed programmable peripheral interconnect controller 0
0x50043000 GLOBAL_MPC03 size 0x1000 — Memory Privilege Controller 1
0x50044000 GLOBAL_PPIB00 size 0x1000 — PPIB APB registers 0
0x50045000 GLOBAL_PPIB01 size 0x1000 — PPIB APB registers 1
0x50049000 GLOBAL_KMU size 0x1000 — Key management unit
0x5004A000 GLOBAL_AAR00 size 0x1000 — Accelerated Address Resolver
0x5004A000 GLOBAL_CCM00 size 0x1000 — AES CCM Mode Encryption
0x5004B000 GLOBAL_ECB00 size 0x1000 — AES ECB Mode Encryption
0x5004C000 GLOBAL_VPR00 size 0x1000 — VPR peripheral registers 2
0x5004D000 GLOBAL_SPIM00 size 0x1000 — Serial Peripheral Interface Master with EasyDMA 0
0x5004D000 GLOBAL_SPIS00 size 0x1000 — SPI Slave 0
0x5004D000 GLOBAL_UARTE00 size 0x1000 — UART with EasyDMA 0
0x5004E000 GLOBAL_MRAMC size 0x1000 — MRAM controller
0x50050400 GLOBAL_GPIOHSPADCTRL size 0x1000 — GPIO high-speed pad control
0x50050400 GLOBAL_P2 size 0x200 — GPIO Port 0
0x50052000 GLOBAL_CTRLAP size 0x1000 — Control access port
0x50053000 GLOBAL_TAD size 0x1000 — Trace and debug control
0x50055000 GLOBAL_TIMER00 size 0x1000 — Timer/Counter 0
0x50056000 GLOBAL_AXONS size 0x1000 — Neural processing unit (NPU)
0x50058000 GLOBAL_EGU00 size 0x1000 — Event generator unit 0
0x50059000 GLOBAL_CRACEN size 0x1000 — CRACEN
0x5005A000 GLOBAL_USBHS size 0x1000 — USBHS
0x5005B000 GLOBAL_MSPI00 size 0x1000 — Multi serial peripheral interface 0
0x5005C000 GLOBAL_MSPI01 size 0x1000 — Multi serial peripheral interface 1
0x5005D000 GLOBAL_SPIM01 size 0x1000 — Serial Peripheral Interface Master with EasyDMA 1
0x5005D000 GLOBAL_SPIS01 size 0x1000 — SPI Slave 1
0x50080000 GLOBAL_SPU10 size 0x1000 — System protection unit 1
0x50082000 GLOBAL_DPPIC10 size 0x1000 — Distributed programmable peripheral interconnect controller 1
0x50083000 GLOBAL_PPIB10 size 0x1000 — PPIB APB registers 2
0x50084000 GLOBAL_PPIB11 size 0x1000 — PPIB APB registers 3
0x50085000 GLOBAL_TIMER10 size 0x1000 — Timer/Counter 1
0x50087000 GLOBAL_EGU10 size 0x1000 — Event generator unit 1
0x5008A000 GLOBAL_RADIO size 0x2000 — 2.4 GHz radio
0x5008D000 GLOBAL_IPCT10 size 0x1000 — IPCT APB registers
0x500C0000 GLOBAL_SPU20 size 0x1000 — System protection unit 2
0x500C2000 GLOBAL_DPPIC20 size 0x1000 — Distributed programmable peripheral interconnect controller 2
0x500C3000 GLOBAL_PPIB20 size 0x1000 — PPIB APB registers 4
0x500C4000 GLOBAL_PPIB21 size 0x1000 — PPIB APB registers 5
0x500C5000 GLOBAL_PPIB22 size 0x1000 — PPIB APB registers 6
0x500C6000 GLOBAL_SPIM20 size 0x1000 — Serial Peripheral Interface Master with EasyDMA 2
0x500C6000 GLOBAL_SPIS20 size 0x1000 — SPI Slave 2
0x500C6000 GLOBAL_TWIM20 size 0x1000 — I2C compatible Two-Wire Master Interface with EasyDMA 0
0x500C6000 GLOBAL_TWIS20 size 0x1000 — I2C compatible Two-Wire Slave Interface with EasyDMA 0
0x500C6000 GLOBAL_UARTE20 size 0x1000 — UART with EasyDMA 1
0x500C7000 GLOBAL_SPIM21 size 0x1000 — Serial Peripheral Interface Master with EasyDMA 3
0x500C7000 GLOBAL_SPIS21 size 0x1000 — SPI Slave 3
0x500C7000 GLOBAL_TWIM21 size 0x1000 — I2C compatible Two-Wire Master Interface with EasyDMA 1
0x500C7000 GLOBAL_TWIS21 size 0x1000 — I2C compatible Two-Wire Slave Interface with EasyDMA 1
0x500C7000 GLOBAL_UARTE21 size 0x1000 — UART with EasyDMA 2
0x500C8000 GLOBAL_SPIM22 size 0x1000 — Serial Peripheral Interface Master with EasyDMA 4
0x500C8000 GLOBAL_SPIS22 size 0x1000 — SPI Slave 4
0x500C8000 GLOBAL_TWIM22 size 0x1000 — I2C compatible Two-Wire Master Interface with EasyDMA 2
0x500C8000 GLOBAL_TWIS22 size 0x1000 — I2C compatible Two-Wire Slave Interface with EasyDMA 2
0x500C8000 GLOBAL_UARTE22 size 0x1000 — UART with EasyDMA 3
0x500C9000 GLOBAL_EGU20 size 0x1000 — Event generator unit 2
0x500CA000 GLOBAL_TIMER20 size 0x1000 — Timer/Counter 2
0x500CB000 GLOBAL_TIMER21 size 0x1000 — Timer/Counter 3
0x500CC000 GLOBAL_TIMER22 size 0x1000 — Timer/Counter 4
0x500CD000 GLOBAL_TIMER23 size 0x1000 — Timer/Counter 5
0x500CE000 GLOBAL_TIMER24 size 0x1000 — Timer/Counter 6
0x500CF000 GLOBAL_MEMCONF size 0x1000 — Memory configuration
0x500D0000 GLOBAL_PDM20 size 0x1000 — Pulse Density Modulation (Digital Microphone) Interface 0
0x500D1000 GLOBAL_PDM21 size 0x1000 — Pulse Density Modulation (Digital Microphone) Interface 1
0x500D2000 GLOBAL_PWM20 size 0x1000 — Pulse width modulation unit 0
0x500D3000 GLOBAL_PWM21 size 0x1000 — Pulse width modulation unit 1
0x500D4000 GLOBAL_PWM22 size 0x1000 — Pulse width modulation unit 2
0x500D5000 GLOBAL_SAADC size 0x1000 — Analog to Digital Converter
0x500D6000 GLOBAL_NFCT size 0x1000 — NFC-A compatible radio NFC-A compatible radio
0x500D7000 GLOBAL_TEMP size 0x1000 — Temperature Sensor
0x500D8200 GLOBAL_P1 size 0x200 — GPIO Port 1
0x500D8600 GLOBAL_P3 size 0x200 — GPIO Port 2
0x500D8800 GLOBAL_P4 size 0x200 — GPIO Port 3
0x500DA000 GLOBAL_GPIOTE20 size 0x1000 — GPIO Tasks and Events 0
0x500E0000 GLOBAL_QDEC20 size 0x1000 — Quadrature Decoder 0
0x500E1000 GLOBAL_QDEC21 size 0x1000 — Quadrature Decoder 1
0x500E2000 GLOBAL_GRTC size 0x1000 — Global Real-time counter
0x500E8000 GLOBAL_TDM size 0x1000 — Time division multiplexed audio interface
0x500ED000 GLOBAL_SPIM23 size 0x1000 — Serial Peripheral Interface Master with EasyDMA 5
0x500ED000 GLOBAL_SPIS23 size 0x1000 — SPI Slave 5
0x500ED000 GLOBAL_TWIM23 size 0x1000 — I2C compatible Two-Wire Master Interface with EasyDMA 3
0x500ED000 GLOBAL_TWIS23 size 0x1000 — I2C compatible Two-Wire Slave Interface with EasyDMA 3
0x500ED000 GLOBAL_UARTE23 size 0x1000 — UART with EasyDMA 4
0x500EE000 GLOBAL_SPIM24 size 0x1000 — Serial Peripheral Interface Master with EasyDMA 6
0x500EE000 GLOBAL_SPIS24 size 0x1000 — SPI Slave 6
0x500EE000 GLOBAL_TWIM24 size 0x1000 — I2C compatible Two-Wire Master Interface with EasyDMA 4
0x500EE000 GLOBAL_TWIS24 size 0x1000 — I2C compatible Two-Wire Slave Interface with EasyDMA 4
0x500EE000 GLOBAL_UARTE24 size 0x1000 — UART with EasyDMA 5
0x500EF000 GLOBAL_TAMPC size 0x1000 — Tamper controller
0x500F1000 GLOBAL_COEXC size 0x1000 — Coexistence controller
0x50100000 GLOBAL_SPU30 size 0x1000 — System protection unit 3
0x50102000 GLOBAL_DPPIC30 size 0x1000 — Distributed programmable peripheral interconnect controller 3
0x50103000 GLOBAL_PPIB30 size 0x1000 — PPIB APB registers 7
0x50104000 GLOBAL_SPIM30 size 0x1000 — Serial Peripheral Interface Master with EasyDMA 7
0x50104000 GLOBAL_SPIS30 size 0x1000 — SPI Slave 7
0x50104000 GLOBAL_TWIM30 size 0x1000 — I2C compatible Two-Wire Master Interface with EasyDMA 5
0x50104000 GLOBAL_TWIS30 size 0x1000 — I2C compatible Two-Wire Slave Interface with EasyDMA 5
0x50104000 GLOBAL_UARTE30 size 0x1000 — UART with EasyDMA 6
0x50106000 GLOBAL_COMP size 0x1000 — Comparator
0x50106000 GLOBAL_LPCOMP size 0x1000 — Low-power comparator
0x50108000 GLOBAL_WDT30 size 0x1000 — Watchdog Timer 0
0x50109000 GLOBAL_WDT31 size 0x1000 — Watchdog Timer 1
0x5010A000 GLOBAL_P0 size 0x200 — GPIO Port 4
0x5010C000 GLOBAL_GPIOTE30 size 0x1000 — GPIO Tasks and Events 1
0x5010E000 GLOBAL_CLOCK size 0x1000 — Clock management
0x5010E000 GLOBAL_POWER size 0x1000 — Power control
0x5010E000 GLOBAL_RESET size 0x1000 — Reset control
0x50111000 GLOBAL_GLITCHDET size 0x1000 — Voltage glitch detectors
0x50120000 GLOBAL_OSCILLATORS size 0x1000 — Oscillator control
0x50120000 GLOBAL_REGULATORS size 0x1000 — Voltage regulators
0x50121000 GLOBAL_VREGUSB size 0x1000 — VREGUSB peripheral
0x50122000 GLOBAL_LFXO size 0x1000 — LFXO peripheral
0x50123000 GLOBAL_LFRC size 0x1000 — LFRC peripheral
0x50124000 GLOBAL_HFXO64M size 0x1000 — HFXO64M peripheral
0x5012A000 GLOBAL_OSCRFR size 0x1000 — OSCRFR peripheral
0x50130000 GLOBAL_AUXPLL size 0x1000 — AUXPLL
0x50130000 GLOBAL_AUXPM size 0x1000 — AUXPM

## Interrupts
0 LMAC_VPR
4 UMAC_VPR
8 MVDMA
64 SPU00 (GLOBAL_SPU00)
65 MPC00 (GLOBAL_MPC00)
67 MPC03 (GLOBAL_MPC03)
74 AAR00_CCM00 (GLOBAL_AAR00, GLOBAL_CCM00)
75 ECB00 (GLOBAL_ECB00)
76 VPR00 (GLOBAL_VPR00)
77 SPIM00_SPIS00_UARTE00 (GLOBAL_SPIM00, GLOBAL_SPIS00, GLOBAL_UARTE00)
78 MRAMC (GLOBAL_MRAMC)
82 CTRLAP (GLOBAL_CTRLAP)
85 TIMER00 (GLOBAL_TIMER00)
88 EGU00 (GLOBAL_EGU00)
89 CRACEN (GLOBAL_CRACEN)
90 USBHS (GLOBAL_USBHS)
91 MSPI00 (GLOBAL_MSPI00)
92 MSPI01 (GLOBAL_MSPI01)
93 SPIM01_SPIS01 (GLOBAL_SPIM01, GLOBAL_SPIS01)
116 BELLBOARD_0 (BELLBOARD)
117 BELLBOARD_1 (BELLBOARD)
118 BELLBOARD_2 (BELLBOARD)
119 BELLBOARD_3 (BELLBOARD)
128 SPU10 (GLOBAL_SPU10)
133 TIMER10 (GLOBAL_TIMER10)
135 EGU10 (GLOBAL_EGU10)
138 RADIO_0 (GLOBAL_RADIO)
139 RADIO_1 (GLOBAL_RADIO)
141 IPCT10_0 (GLOBAL_IPCT10)
142 IPCT10_1 (GLOBAL_IPCT10)
143 IPCT10_2 (GLOBAL_IPCT10)
144 IPCT10_3 (GLOBAL_IPCT10)
192 SPU20 (GLOBAL_SPU20)
198 SPIM20_SPIS20_TWIM20_TWIS20_UARTE20 (GLOBAL_SPIM20, GLOBAL_SPIS20, GLOBAL_TWIM20, GLOBAL_TWIS20, GLOBAL_UARTE20)
199 SPIM21_SPIS21_TWIM21_TWIS21_UARTE21 (GLOBAL_SPIM21, GLOBAL_SPIS21, GLOBAL_TWIM21, GLOBAL_TWIS21, GLOBAL_UARTE21)
200 SPIM22_SPIS22_TWIM22_TWIS22_UARTE22 (GLOBAL_SPIM22, GLOBAL_SPIS22, GLOBAL_TWIM22, GLOBAL_TWIS22, GLOBAL_UARTE22)
201 EGU20 (GLOBAL_EGU20)
202 TIMER20 (GLOBAL_TIMER20)
203 TIMER21 (GLOBAL_TIMER21)
204 TIMER22 (GLOBAL_TIMER22)
205 TIMER23 (GLOBAL_TIMER23)
206 TIMER24 (GLOBAL_TIMER24)
208 PDM20 (GLOBAL_PDM20)
209 PDM21 (GLOBAL_PDM21)
210 PWM20 (GLOBAL_PWM20)
211 PWM21 (GLOBAL_PWM21)
212 PWM22 (GLOBAL_PWM22)
213 SAADC (GLOBAL_SAADC)
214 NFCT (GLOBAL_NFCT)
215 TEMP (GLOBAL_TEMP)
218 GPIOTE20_0 (GLOBAL_GPIOTE20)
219 GPIOTE20_1 (GLOBAL_GPIOTE20)
224 QDEC20 (GLOBAL_QDEC20)
225 QDEC21 (GLOBAL_QDEC21)
226 GRTC_0 (GLOBAL_GRTC)
227 GRTC_1 (GLOBAL_GRTC)
228 GRTC_2 (GLOBAL_GRTC)
229 GRTC_3 (GLOBAL_GRTC)
230 GRTC_4 (GLOBAL_GRTC)
231 GRTC_5 (GLOBAL_GRTC)
232 TDM (GLOBAL_TDM)
237 SPIM23_SPIS23_TWIM23_TWIS23_UARTE23 (GLOBAL_SPIM23, GLOBAL_SPIS23, GLOBAL_TWIM23, GLOBAL_TWIS23, GLOBAL_UARTE23)
238 SPIM24_SPIS24_TWIM24_TWIS24_UARTE24 (GLOBAL_SPIM24, GLOBAL_SPIS24, GLOBAL_TWIM24, GLOBAL_TWIS24, GLOBAL_UARTE24)
239 TAMPC (GLOBAL_TAMPC)
256 SPU30 (GLOBAL_SPU30)
260 SPIM30_SPIS30_TWIM30_TWIS30_UARTE30 (GLOBAL_SPIM30, GLOBAL_SPIS30, GLOBAL_TWIM30, GLOBAL_TWIS30, GLOBAL_UARTE30)
262 COMP_LPCOMP (GLOBAL_COMP, GLOBAL_LPCOMP)
264 WDT30 (GLOBAL_WDT30)
265 WDT31 (GLOBAL_WDT31)
268 GPIOTE30_0 (GLOBAL_GPIOTE30)
269 GPIOTE30_1 (GLOBAL_GPIOTE30)
270 CLOCK_POWER (GLOBAL_CLOCK, GLOBAL_POWER)
289 VREGUSB (GLOBAL_VREGUSB)
290 LFXO (GLOBAL_LFXO)
291 LFRC (GLOBAL_LFRC)
292 HFXO64M (GLOBAL_HFXO64M)
304 AUXPLL_AUXPM (GLOBAL_AUXPLL, GLOBAL_AUXPM)

## Licence text in the file
Copyright (c) 2010 - 2026, Nordic Semiconductor ASA All rights reserved. SPDX-License-Identifier: BSD-3-Clause Redistribution and use in source and binary forms, with or without modification, are permitted provided that the following conditions are met: 1. Redistributions of source code must retain the above copyright notice, this list of conditions and the following disclaimer. 2. Redistributions in binary form must reproduce the above copyright notice, this list of conditions and the following disclaimer in the documentation and/or other materials provided with the distribution. 3. Neither the name of Nordic Semiconductor ASA nor the names of its contributors may be used to endorse or promote products derived from this software without specific prior written permission. THIS SOFTWARE IS PROVIDED BY THE COPYRIGHT HOLDERS AND CONTRIBUTORS "AS IS" AND ANY EXPRESS OR IMPLIED WARRANTIES, INCLUDING, BUT NOT LIMITED TO, THE IMPLIED WARRANTIES OF MERCHANTABILITY, AND FITNESS FOR A PARTICULAR PURPOSE ARE DISCLAIMED. IN NO EVENT SHALL NORDIC SEMICONDUCTOR ASA OR CONTRIBUTORS BE LIABLE FOR ANY DIRECT, INDIRECT, INCIDENTAL, SPECIAL, EXEMPLARY, OR CONSEQUENTIAL DAMAGES (INCLUDING, BUT NOT LIMITED TO, PROCUREMENT OF SUBSTITUTE GOODS OR SERVICES; LOSS OF USE, DATA, OR PROFITS; OR BUSINESS INTERRUPTION) HOWEVER CAUSED AND ON ANY THEORY OF LIABILITY, WHETHER IN CONTRACT, STRICT LIABILITY, OR TORT (INCLUDING NEGLIGENCE OR OTHERWISE) ARISING IN ANY WAY OUT OF THE USE OF THIS SOFTWARE, EVEN IF ADVISED OF THE POSSIBILITY OF SUCH DAMAGE.
